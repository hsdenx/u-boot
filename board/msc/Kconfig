## board/msc/Kconfig
```kconfig
if TARGET_NR_IMX6
source "board/msc/nR_imx6/Kconfig"

config USE_UART1
config USE_UART2
config USE_UART3

choice
	prompt "Console device"
	default USE_UART2

	config USE_UART1
		bool "ttymxc0"

	config USE_UART2
		bool "ttymxc1"

	config USE_UART3
		bool "ttymxc2"
endchoice

choice
	prompt "Environment location"
	default ENV_IS_IN_MMC

	config ENV_IS_IN_MMC
		bool "mmc0"

	config ENV_IS_IN_SPI_FLASH
		bool "spi flash"
endchoice
endif
```

## board/msc/nR_imx6/Kconfig
```kconfig
if TARGET_NR_IMX6

config SYS_BOARD
	default "nR_imx6"

config SYS_VENDOR
	default "msc"

config SYS_SOC
	default "mx6"

config SYS_CONFIG_NAME
	default "msc_nR_imx6"

config SYS_USE_VIDEO
	bool

config SYS_USE_HDMI_VIDEO
	bool "HDMI based display support"
	default n
	select SYS_USE_VIDEO

config SYS_USE_LVDS_VIDEO
	bool "LVDS based panel/display support"
	default n
	select SYS_USE_VIDEO

config SYS_USE_LCD_VIDEO
	bool "LCD (TTL) based panel/display support"
	default n
	select SYS_USE_VIDEO

config CMD_BOARDINFO
	bool "boardinfo command"
	default y
	help
	  command to show msc boardinfo

config BOARDINFO_OVERWRITE_PROTECTION
	bool "boardinfo overwrite protection"
	depends on CMD_BOARDINFO
	default n
	help
	  protect boardinfo from overwrites.
endif
```

## board/siemens/smartweb_hw/Kconfig
```kconfig
if TARGET_SMARTWEB_HW

config SYS_BOARD
	default "smartweb_hw"

config SYS_VENDOR
	default "siemens"

config SYS_CONFIG_NAME
	default "smartweb_hw"

endif
```

## configs/bosch_mpcxxxxd_spi_defconfig
```kconfig
CONFIG_ARM=y
CONFIG_ARCH_MX6=y
CONFIG_SPL_GPIO_SUPPORT=y
CONFIG_SPL_LIBCOMMON_SUPPORT=y
CONFIG_SPL_LIBGENERIC_SUPPORT=y
CONFIG_TARGET_NR_IMX6=y
CONFIG_IMX6_CAN_CLK_INIT=y
CONFIG_IMX6_CAN_CLK_DIV=3
CONFIG_SPL_I2C_SUPPORT=y
CONFIG_SPL_MMC_SUPPORT=y
CONFIG_SPL_SERIAL_SUPPORT=y
CONFIG_SPL_SPI_FLASH_SUPPORT=y
CONFIG_SPL_SPI_SUPPORT=y
CONFIG_SPL_WATCHDOG_SUPPORT=y
CONFIG_USE_UART3=y
CONFIG_ENV_IS_IN_SPI_FLASH=y
CONFIG_SPL_STACK_R_ADDR=0x11000000
CONFIG_SYS_EXTRA_OPTIONS="IMX_CONFIG=arch/arm/imx-common/spl_sd.cfg,MX6QDL"
CONFIG_SPL=y
CONFIG_SPL_STACK_R=y
CONFIG_HUSH_PARSER=y
CONFIG_CMD_BOOTZ=y
# CONFIG_CMD_IMLS is not set
# CONFIG_CMD_FLASH is not set
CONFIG_CMD_MMC=y
CONFIG_CMD_SF=y
CONFIG_CMD_I2C=y
CONFIG_CMD_USB=y
# CONFIG_CMD_FPGA is not set
CONFIG_CMD_DHCP=y
CONFIG_CMD_MII=y
CONFIG_CMD_PING=y
CONFIG_CMD_CACHE=y
CONFIG_CMD_EXT2=y
CONFIG_CMD_EXT4=y
CONFIG_CMD_FAT=y
CONFIG_SPI_FLASH=y
CONFIG_SPI_FLASH_ATMEL=y
CONFIG_SPI_FLASH_SPANSION=y
CONFIG_SPI_FLASH_STMICRO=y
CONFIG_OF_LIBFDT=y
# CONFIG_EFI_LOADER is not set
```

## configs/corvus_defconfig
```kconfig
CONFIG_SPL=y
CONFIG_SYS_EXTRA_OPTIONS="AT91SAM9M10G45,MACH_TYPE=2066,SYS_USE_NANDFLASH"
+S:CONFIG_ARM=y
+S:CONFIG_TARGET_CORVUS=y
```

## configs/smartweb_hw_defconfig
```kconfig
CONFIG_SPL=y
CONFIG_SYS_EXTRA_OPTIONS="AT91SAM9260"
+S:CONFIG_ARM=y
+S:CONFIG_ARCH_AT91=y
+S:CONFIG_TARGET_SMARTWEB_HW=y
```
